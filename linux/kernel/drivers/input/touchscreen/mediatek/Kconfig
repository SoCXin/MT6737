## linux/kernel/drivers/input/touchscreen/mediatek/Kconfig
```kconfig
#
# Touchscreen driver configuration
#
menuconfig INPUT_TOUCHSCREEN
	bool "Touchscreens"
	help
	  Say Y here, and a list of supported touchscreens will be displayed.
	  This option doesn't affect the kernel.

	  If unsure, say Y.

if INPUT_TOUCHSCREEN

config TOUCHSCREEN_MTK
	bool "MediaTek Touch Panel Driver"
	help
	  Say Y here if you have MediaTek touch panel.

	  If unsure, say N.

	  To compile this dirver as a module, choose M here: the
	  module will be called.

config TOUCHSCREEN_MTK_GT1XX_GS
	bool "TOUCHSCREEN_MTK_GT1XX_GS for Mediatek package"
	default n
	help
	  Say Y here if you have TOUCHSCREEN_MTK_GT1XX_GS touch panel.

	  If unsure, say N.

	  To compile this dirver as a module, choose M here: the
	  module will be called.
	  
source "drivers/input/touchscreen/mediatek/GT1XX_GS/Kconfig"

config TOUCHSCREEN_MTK_GT9XX_GS
	bool "TOUCHSCREEN_MTK_GT9XX_GS for Mediatek package"
	default n
	help
	  Say Y here if you have TOUCHSCREEN_MTK_GT9XX_GS touch panel.

	  If unsure, say N.

	  To compile this dirver as a module, choose M here: the
	  module will be called.
	  
source "drivers/input/touchscreen/mediatek/GT9XX_GS/Kconfig"

config TOUCHSCREEN_MTK_GT9XX_HOTKNOT_SCP
	bool "GT9XX_HOTKNOT_SCP for Mediatek package"
	default n
	help
	  Say Y here if you have GT9XX_HOTKNOT_SCP touch panel.

	  If unsure, say N.

	  To compile this dirver as a module, choose M here: the
	  module will be called.
	  
source "drivers/input/touchscreen/mediatek/GT9XX_hotknot_scp/Kconfig"

config TOUCHSCREEN_MTK_FOCALTECH
	bool "FOCALTECH for Mediatek package"
	default n
	help
	  Say Y here if you have FOCALTECH touch panel.

	  If unsure, say N.

	  To compile this dirver as a module, choose M here: the
	  module will be called.
	  
source "drivers/input/touchscreen/mediatek/focaltech/Kconfig"
	  
config TOUCHSCREEN_MTK_MSTAR
	bool "MSTAR for Mediatek package"
	default n
	help
	  Say Y here if you have MSTAR touch panel.

	  If unsure, say N.

	  To compile this dirver as a module, choose M here: the
	  module will be called.
	  
endif
```

## linux/kernel/drivers/misc/mediatek/accelerometer/KXTJ2_1009/Kconfig
```kconfig
config MTK_KXTJ2_1009
	bool "zhoucheng add MTK_KXTJ2_1009"
	default n
	help
	  It support different accelerometer sensor.
          If this option is set,
	  it will support
          MTK_KXTJ9_1002_NEW Accelerometer.
```

## linux/kernel/drivers/misc/mediatek/accelerometer/mir3da/Kconfig
```kconfig
config MTK_MIR3DA
	bool "MIR3DA for MediaTek package"
	default n
	help
	  It support different accelerometer sensor.
          If this option is set,
	  it will support
          MIR3DA Accelerometer.
```

## linux/kernel/drivers/misc/mediatek/alsps/ap3xx/Kconfig
```kconfig
config MTK_AP3XX
	bool "MTK_AP3XX for MediaTek package"
	default n
	help
	It support different type sensor
	in this platform. If this option
	is set, it will support ambient
	and light sensor MTK_LTR559.
```

## linux/kernel/drivers/misc/mediatek/alsps/ltr559/Kconfig
```kconfig
config MTK_LTR559
	bool "MTK_LTR559 for MediaTek package"
	default n
	help
	It support different type sensor
	in this platform. If this option
	is set, it will support ambient
	and light sensor MTK_LTR559.
```

## linux/kernel/drivers/misc/mediatek/alsps/mn25713e/Kconfig
```kconfig
config MTK_MN25713
        bool "mn25713 for MediaTek package"
        default n
	help
	It support different type sensor
	in this platform. If this option
	is set, it will support ambient
	and light sensor STK3311WV.
```

## linux/kernel/drivers/misc/mediatek/alsps/stk3x1x/Kconfig
```kconfig
config MTK_STK3x1x
        bool "stk3311wv for MediaTek package"
        default n
	help
	It support different type sensor
	in this platform. If this option
	is set, it will support ambient
	and light sensor STK3311WV.
```

## linux/kernel/drivers/misc/mediatek/alsps/txc_pa122/Kconfig
```kconfig
config MTK_PA122_NEW
	bool "zhoucheng add PA12201001 for MediaTek package"
	default n
	help
	  It support different alsps sensor.
          If this option is set,
	  it will support
          PA12201001 alsps.
```

## linux/kernel/drivers/misc/mediatek/breathled/Kconfig
```kconfig
config CUSTOM_KERNEL_BREATHLED
	bool "CUSTOM_KERNEL_BREATHLED"
	help
	  breathled sensor driver

source "drivers/misc/mediatek/breathled/fy6203/Kconfig"
```

## linux/kernel/drivers/misc/mediatek/breathled/fy6203/Kconfig
```kconfig
config MTK_BREATHLED_FY6203
	bool "MTK_BREATHLED_FY6203"
	default n
	help
	  It support different breath .
          If this option is set,
	  it will support
          breath fy6203 led.
```

## linux/kernel/drivers/misc/mediatek/fingerprint/Kconfig
```kconfig
config CUSTOM_KERNEL_FINGER
	bool "CUSTOM_KERNEL_FINGER"
	help
	  FINGER sensor driver

source "drivers/misc/mediatek/fingerprint/gfx1xm/Kconfig"
source "drivers/misc/mediatek/fingerprint/sw9362n/Kconfig"
source "drivers/misc/mediatek/fingerprint/icnfpsensor/Kconfig"
source "drivers/misc/mediatek/fingerprint/fegefpsensor/Kconfig"
```

## linux/kernel/drivers/misc/mediatek/fingerprint/fegefpsensor/Kconfig
```kconfig
config MTK_FEGE_FINGER
	bool "MTK_FEGE_FINGER"
	default n
	help
	  it will support fege sensor.
```

## linux/kernel/drivers/misc/mediatek/fingerprint/gfx1xm/Kconfig
```kconfig
config MTK_GOODIX_FINGER
	bool "zhoucheng add MTK_GOODIX_FINGER"
	default n
	help
	  It support different alsps sensor.
          If this option is set,
	  it will support
          goodix sensor.
```

## linux/kernel/drivers/misc/mediatek/fingerprint/icnfpsensor/Kconfig
```kconfig
config MTK_ICN_FINGER
	bool "zhoucheng add MTK_ICN_FINGER"
	default n
	help
	  It support different alsps sensor.
          If this option is set,
	  it will support
          icn sensor.
```

## linux/kernel/drivers/misc/mediatek/fingerprint/sw9362n/Kconfig
```kconfig
config MTK_SUNWAVE_FINGER
	bool "zhoucheng add MTK_SUNWAVE_FINGER"
	default n
	help
	  It support different alsps sensor.
          If this option is set,
	  it will support
          sunwave sensor.
```

## linux/kernel/drivers/misc/mediatek/gpio_test/Kconfig
```kconfig
config CUSTOM_KERNEL_IOTEST
	bool "runyee kernel gpio export pin test"
	default n
	---help---
	  runyee kernel gpio export pin test
```

## linux/kernel/drivers/misc/mediatek/leds/Kconfig
```kconfig
config MTK_LEDS
	tristate "MediaTek LED Support"
	depends on LEDS_CLASS
	---help---
	  This selects the MediaTek(R) LEDs connected to MediaTek chips.
	  If you want to use MediaTek(R) LEDs support, say Y or M here.
	  If unsure, say N.
	  Mediatek LED module includes backlight, indicate LED, keypad LED, button LED etc.

config RUNYEE_LEDS_BUTTON
  bool RUNYEE_LEDS_BUTTON
  default n
  help
    RUNYEE_LEDS_BUTTON
    
config LIGHTNESS_MAPPING_VALUE
	int "LIGHTNESS_MAPPING_VALUE"
	default 255
 	---help---
	  Backlight brightness mapping value, from 0 to 255.

config TB8173_EVB
	bool "Support TB8173 EVB board"
```

## linux/kernel/drivers/misc/mediatek/remote/Kconfig
```kconfig
config CUSTOM_KERNEL_REMOTE
	bool "CUSTOM_KERNEL_REMOTE"
	help
	  remote sensor driver

source "drivers/misc/mediatek/remote/et4003yd18/Kconfig"
```

## linux/kernel/drivers/misc/mediatek/remote/et4003yd18/Kconfig
```kconfig
config MTK_REMOTE_ET4003
	bool "MTK_REMOTE_ET4003"
	default n
	help
	  It support different remote sensor.
          If this option is set,
	  it will support
          remote et4003 sensor.
```
