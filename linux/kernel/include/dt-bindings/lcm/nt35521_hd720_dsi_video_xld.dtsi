/*
 * Mediatek's LCM driver device tree
 *
 * Copyright (c) 2013 MediaTek Co., Ltd.
 *              http://www.mediatek.com
 *
 */

#include "lcm_define.h"

/ {
	/* LCM standardization */
	lcm_params {
		compatible = "mediatek,lcm_params-nt35521_hd720_dsi_video_xld";

		lcm_params-types = <2 0 0 0>;
		/* type, ctrl, lcm_if, lcm_cmd_if */
		lcm_params-resolution = <720 1280>;
		/* width, height */
		lcm_params-io_select_mode;

		lcm_params-dbi-port;
		lcm_params-dbi-clock_freq;
		lcm_params-dbi-data_width;
		lcm_params-dbi-data_format;
		/* color_order, trans_seq, padding, format, width */
		lcm_params-dbi-cpu_write_bits;
		lcm_params-dbi-io_driving_current;
		lcm_params-dbi-msb_io_driving_current;
		lcm_params-dbi-ctrl_io_driving_current;

		lcm_params-dbi-te_mode;
		lcm_params-dbi-te_edge_polarity;
		lcm_params-dbi-te_hs_delay_cnt;
		lcm_params-dbi-te_vs_width_cnt;
		lcm_params-dbi-te_vs_width_cnt_div;

		lcm_params-dbi-serial-params0;
		/* cs_polarity, clk_polarity, clk_phase, is_non_dbi_mode, clock_base, clock_div */
		lcm_params-dbi-serial-params1;
		/* css, csh, rd_1st, rd_2nd, wr_1st, wr_2nd */
		lcm_params-dbi-serial-params2;
		/* sif_1st_pol, sif_sck_def, sif_3wire, sif_sdi sif_div2, sif_hw_cs */
		lcm_params-dbi-parallel-params0;
		/* write_setup, write_hold, write_wait, read_setup */
		lcm_params-dbi-parallel-params1;
		/* read_hold, read_latency, wait_period, cs_high_width */

		lcm_params-dpi-mipi_pll_clk_ref;
		lcm_params-dpi-mipi_pll_clk_div1;
		lcm_params-dpi-mipi_pll_clk_div2;
		lcm_params-dpi-mipi_pll_clk_fbk_div;

		lcm_params-dpi-dpi_clk_div;
		lcm_params-dpi-dpi_clk_duty;
		lcm_params-dpi-PLL_CLOCK;
		lcm_params-dpi-dpi_clock;
		lcm_params-dpi-ssc_disable;
		lcm_params-dpi-ssc_range;

		lcm_params-dpi-width;
		lcm_params-dpi-height;
		lcm_params-dpi-bg_width;
		lcm_params-dpi-bg_height;

		lcm_params-dpi-clk_pol;
		lcm_params-dpi-de_pol;
		lcm_params-dpi-vsync_pol;
		lcm_params-dpi-hsync_pol;
		lcm_params-dpi-hsync_pulse_width;
		lcm_params-dpi-hsync_back_porch;
		lcm_params-dpi-hsync_front_porch;
		lcm_params-dpi-vsync_pulse_width;
		lcm_params-dpi-vsync_back_porch;
		lcm_params-dpi-vsync_front_porch;

		lcm_params-dpi-format;
		lcm_params-dpi-rgb_order;
		lcm_params-dpi-is_serial_output;
		lcm_params-dpi-i2x_en;
		lcm_params-dpi-i2x_edge;
		lcm_params-dpi-embsync;
		lcm_params-dpi-lvds_tx_en;
		lcm_params-dpi-bit_swap;
		lcm_params-dpi-intermediat_buffer_num;
		lcm_params-dpi-io_driving_current;
		lcm_params-dpi-lsb_io_driving_current;

		lcm_params-dsi-mode = <2>;
		lcm_params-dsi-switch_mode = <0>;
		lcm_params-dsi-DSI_WMEM_CONTI;
		lcm_params-dsi-DSI_RMEM_CONTI;
		lcm_params-dsi-VC_NUM;
		lcm_params-dsi-lane_num = <4>;
		lcm_params-dsi-data_format = <2 0 0 2>;
		/* color_order, trans_seq, padding, format */
		lcm_params-dsi-intermediat_buffer_num;
		lcm_params-dsi-ps = <2>;
		lcm_params-dsi-word_count;
		lcm_params-dsi-packet_size = <256>;

		lcm_params-dsi-vertical_sync_active = <4>;
		lcm_params-dsi-vertical_backporch = <16>;
		lcm_params-dsi-vertical_frontporch = <16>;
		lcm_params-dsi-vertical_frontporch_for_low_power;
		lcm_params-dsi-vertical_active_line = <1280>;
		lcm_params-dsi-horizontal_sync_active = <10>;
		lcm_params-dsi-horizontal_backporch = <60>;
		lcm_params-dsi-horizontal_frontporch = <60>;
		lcm_params-dsi-horizontal_blanking_pixel;
		lcm_params-dsi-horizontal_active_pixel = <720>;
		lcm_params-dsi-horizontal_bllp;
		lcm_params-dsi-line_byte;
		lcm_params-dsi-horizontal_sync_active_byte;
		lcm_params-dsi-horizontal_backportch_byte;
		lcm_params-dsi-horizontal_frontporch_byte;
		lcm_params-dsi-rgb_byte;
		lcm_params-dsi-horizontal_sync_active_word_count;
		lcm_params-dsi-horizontal_backporch_word_count;
		lcm_params-dsi-horizontal_frontporch_word_count;

		lcm_params-dsi-HS_TRAIL;
		lcm_params-dsi-ZERO;
		lcm_params-dsi-HS_PRPR;
		lcm_params-dsi-LPX;
		lcm_params-dsi-TA_SACK;
		lcm_params-dsi-TA_GET;
		lcm_params-dsi-TA_SURE;
		lcm_params-dsi-TA_GO;
		lcm_params-dsi-CLK_TRAIL;
		lcm_params-dsi-CLK_ZERO;
		lcm_params-dsi-LPX_WAIT;
		lcm_params-dsi-CONT_DET;
		lcm_params-dsi-CLK_HS_PRPR;
		lcm_params-dsi-CLK_HS_POST;
		lcm_params-dsi-DA_HS_EXIT;
		lcm_params-dsi-CLK_HS_EXIT;

		lcm_params-dsi-pll_select;
		lcm_params-dsi-pll_div1;
		lcm_params-dsi-pll_div2;
		lcm_params-dsi-fbk_div;
		lcm_params-dsi-fbk_sel;
		lcm_params-dsi-rg_bir;
		lcm_params-dsi-rg_bic;
		lcm_params-dsi-rg_bp;
		lcm_params-dsi-pll_clock = <208>;
		lcm_params-dsi-dsi_clock;
		lcm_params-dsi-ssc_disable;
		lcm_params-dsi-ssc_range;
		lcm_params-dsi-compatibility_for_nvk;
		lcm_params-dsi-cont_clock;

		lcm_params-dsi-ufoe_enable;
		lcm_params-dsi-ufoe_params;
		/* compress_ratio, lr_mode_en, vlc_disable, vlc_config */
		lcm_params-dsi-edp_panel;

		lcm_params-dsi-customization_esd_check_enable = <0>;
		lcm_params-dsi-esd_check_enable = <1>;

		lcm_params-dsi-lcm_int_te_monitor;
		lcm_params-dsi-lcm_int_te_period;
		lcm_params-dsi-lcm_ext_te_monitor;
		lcm_params-dsi-lcm_ext_te_enable;

		lcm_params-dsi-noncont_clock;
		lcm_params-dsi-noncont_clock_period;
		lcm_params-dsi-clk_lp_per_line_enable = <0>;

		lcm_params-dsi-lcm_esd_check_table0 = <0x0A 0x01 0x9C 0x0>;
		/* cmd, count, para_list[0], para_list[1] */
		lcm_params-dsi-lcm_esd_check_table1;
		lcm_params-dsi-lcm_esd_check_table2;

		lcm_params-dsi-switch_mode_enable = <0>;
		lcm_params-dsi-dual_dsi_type;
		lcm_params-dsi-lane_swap_en;
		lcm_params-dsi-lane_swap0;
		/* lane_swap[0][0~5] */
		lcm_params-dsi-lane_swap1;
		/* lane_swap[1][0~5] */
		lcm_params-dsi-vertical_vfp_lp;
		lcm_params-physical_width;
		lcm_params-physical_height;
		lcm_params-od_table_size;
		lcm_params-od_table;
	};

	lcm_ops {
		compatible = "mediatek,lcm_ops-nt35521_hd720_dsi_video_xld";

		init = <LCM_FUNC_UTIL LCM_UTIL_RESET 1 LCM_UTIL_RESET_LOW>,
			<LCM_FUNC_UTIL LCM_UTIL_MDELAY 1 10>,
			<LCM_FUNC_UTIL LCM_UTIL_RESET 1 LCM_UTIL_RESET_HIGH>,
			<LCM_FUNC_UTIL LCM_UTIL_MDELAY 1 10>,
			<LCM_FUNC_CMD LCM_UTIL_WRITE_CMD_V2 6 0xFF 4 0xAA 0x55 0x25 0x01>,
			<LCM_FUNC_CMD LCM_UTIL_WRITE_CMD_V2 3 0xFC 1 0x08>,

			<LCM_FUNC_CMD LCM_UTIL_WRITE_CMD_V2 3 0xFC 1 0x00>,
			      
			<LCM_FUNC_CMD LCM_UTIL_WRITE_CMD_V2 3 0x6F 1 0x21>,
			<LCM_FUNC_CMD LCM_UTIL_WRITE_CMD_V2 3 0xF7 1 0x01>,

			<LCM_FUNC_CMD LCM_UTIL_WRITE_CMD_V2 3 0x6F 1 0x21>,
			<LCM_FUNC_CMD LCM_UTIL_WRITE_CMD_V2 3 0xF7 1 0x00>,
			<LCM_FUNC_CMD LCM_UTIL_WRITE_CMD_V2 6 0xFF 4 0xAA 0x55 0x25 0x00>, 

			        
			<LCM_FUNC_CMD LCM_UTIL_WRITE_CMD_V2 7 0xF0 5 0x55 0xAA 0x52 0x08 0x00>,                
			<LCM_FUNC_CMD LCM_UTIL_WRITE_CMD_V2 3 0xC8 1 0x83>,                
			        
			<LCM_FUNC_CMD LCM_UTIL_WRITE_CMD_V2 4 0xB1 2 0x68 0x27>,               
			        
			<LCM_FUNC_CMD LCM_UTIL_WRITE_CMD_V2 3 0xB6 1 0x08>,                
			        
			<LCM_FUNC_CMD LCM_UTIL_WRITE_CMD_V2 3 0x6F 1 0x02>,                
			<LCM_FUNC_CMD LCM_UTIL_WRITE_CMD_V2 3 0xB8 1 0x08>,                
			        
			<LCM_FUNC_CMD LCM_UTIL_WRITE_CMD_V2 4 0xBB 2 0x74 0x44>,               
			        
			<LCM_FUNC_CMD LCM_UTIL_WRITE_CMD_V2 4 0xBC 2 0x00 0x00>,               
			        
			<LCM_FUNC_CMD LCM_UTIL_WRITE_CMD_V2 7 0xBD 5 0x02 0xB0 0x1E 0x1E 0x00>,        
			<LCM_FUNC_CMD LCM_UTIL_WRITE_CMD_V2 4 0xC5 2 0x01 0x07>,       
			        
			<LCM_FUNC_CMD LCM_UTIL_WRITE_CMD_V2 7 0xF0 5 0x55 0xAA 0x52 0x08 0x01>,                
			        
			<LCM_FUNC_CMD LCM_UTIL_WRITE_CMD_V2 4 0xB0 2 0x05 0x05>,               
			<LCM_FUNC_CMD LCM_UTIL_WRITE_CMD_V2 4 0xB1 2 0x05 0x05>,   
			<LCM_FUNC_CMD LCM_UTIL_WRITE_CMD_V2 4 0xB6 2 0x05 0x05>,           
			        
			<LCM_FUNC_CMD LCM_UTIL_WRITE_CMD_V2 4 0xBC 2 0xA0 0x01>,           
			<LCM_FUNC_CMD LCM_UTIL_WRITE_CMD_V2 4 0xBD 2 0xA0 0x01>,               
			        
			<LCM_FUNC_CMD LCM_UTIL_WRITE_CMD_V2 3 0xCA 1 0x00>,        
			           
			<LCM_FUNC_CMD LCM_UTIL_WRITE_CMD_V2 3 0xC0 1 0x04>,                
			        
			<LCM_FUNC_CMD LCM_UTIL_WRITE_CMD_V2 3 0xBE 1 0x6d>,
			        
			<LCM_FUNC_CMD LCM_UTIL_WRITE_CMD_V2 4 0xB3 2 0x37 0x37>,               
			<LCM_FUNC_CMD LCM_UTIL_WRITE_CMD_V2 4 0xB4 2 0x0F 0x0F>,               
			        
			<LCM_FUNC_CMD LCM_UTIL_WRITE_CMD_V2 4 0xB9 2 0x46 0x46>,           
			<LCM_FUNC_CMD LCM_UTIL_WRITE_CMD_V2 4 0xBA 2 0x25 0x25>,               
			        
			<LCM_FUNC_CMD LCM_UTIL_WRITE_CMD_V2 7 0xF0 5 0x55 0xAA 0x52 0x08 0x02>,                
			        
			<LCM_FUNC_CMD LCM_UTIL_WRITE_CMD_V2 3 0xEE 1 0x03>,            
			      
			<LCM_FUNC_CMD LCM_UTIL_WRITE_CMD_V2 18 0xB0 16 0x00 0xf6 0x01 0x00 0x01 0x0c 0x01 0x19 0x01 0x25 0x01 0x3b 0x01 0x4f 0x01 0x70>,            
			<LCM_FUNC_CMD LCM_UTIL_WRITE_CMD_V2 18 0xB1 16 0x01 0x8f 0x01 0xBf 0x01 0xe3 0x02 0x22 0x02 0x59 0x02 0x5b 0x02 0x8f 0x02 0xc6>,            
			<LCM_FUNC_CMD LCM_UTIL_WRITE_CMD_V2 18 0xB2 16 0x02 0xeb 0x03 0x1e 0x03 0x3c 0x03 0x75 0x03 0x92 0x03 0xaf 0x03 0xc6 0x03 0xD8>,            
			<LCM_FUNC_CMD LCM_UTIL_WRITE_CMD_V2 6 0xB3 4  0x03 0xE6 0x03 0xFF>,         
			<LCM_FUNC_CMD LCM_UTIL_WRITE_CMD_V2 18 0xB4 16 0x00 0xb0 0x00 0xBa 0x00 0xcd 0x00 0xe0 0x00 0xee 0x01 0x0d 0x01 0x27 0x01 0x4c>,            
			<LCM_FUNC_CMD LCM_UTIL_WRITE_CMD_V2 18 0xB5 16 0x01 0x6d 0x01 0xa7 0x01 0xd3 0x02 0x15 0x02 0x4e 0x02 0x50 0x02 0x86 0x02 0xbf>,            
			<LCM_FUNC_CMD LCM_UTIL_WRITE_CMD_V2 18 0xB6 16 0x02 0xe5 0x03 0x1D 0x03 0x3B 0x03 0x70 0x03 0x90 0x03 0xa9 0x03 0xC1 0x03 0xDA>,            
			<LCM_FUNC_CMD LCM_UTIL_WRITE_CMD_V2 6 0xB7 4 0x03 0xE6 0x03 0xFF>,         
			<LCM_FUNC_CMD LCM_UTIL_WRITE_CMD_V2 18 0xB8 16 0x00 0x00 0x00 0x24 0x00 0x4c 0x00 0x66 0x00 0x7b 0x00 0xa4 0x00 0xca 0x01 0x0b>,            
			<LCM_FUNC_CMD LCM_UTIL_WRITE_CMD_V2 18 0xB9 16 0x01 0x36 0x01 0x78 0x01 0xb2 0x02 0x05 0x02 0x3d 0x02 0x3f 0x02 0x77 0x02 0xb2>,            
			<LCM_FUNC_CMD LCM_UTIL_WRITE_CMD_V2 18 0xBA 16 0x02 0xd8 0x03 0x1b 0x03 0x3d 0x03 0x7a 0x03 0x9a 0x03 0xba 0x03 0xd6 0x03 0xdf>,            
			<LCM_FUNC_CMD LCM_UTIL_WRITE_CMD_V2 6 0xBB 4 0x03 0xfb 0x03 0xFF>,         
			  
			        
			<LCM_FUNC_CMD LCM_UTIL_WRITE_CMD_V2 7 0xF0 5 0x55 0xAA 0x52 0x08 0x06>,                
			<LCM_FUNC_CMD LCM_UTIL_WRITE_CMD_V2 4 0xB0 2 0x29 0x2A>,               
			<LCM_FUNC_CMD LCM_UTIL_WRITE_CMD_V2 4 0xB1 2 0x10 0x12>,               
			<LCM_FUNC_CMD LCM_UTIL_WRITE_CMD_V2 4 0xB2 2 0x14 0x16>,               
			<LCM_FUNC_CMD LCM_UTIL_WRITE_CMD_V2 4 0xB3 2 0x18 0x1A>,               
			<LCM_FUNC_CMD LCM_UTIL_WRITE_CMD_V2 4 0xB4 2 0x08 0x0A>,               
			<LCM_FUNC_CMD LCM_UTIL_WRITE_CMD_V2 4 0xB5 2 0x2E 0x2E>,               
			<LCM_FUNC_CMD LCM_UTIL_WRITE_CMD_V2 4 0xB6 2 0x2E 0x2E>,               
			<LCM_FUNC_CMD LCM_UTIL_WRITE_CMD_V2 4 0xB7 2 0x2E 0x2E>,               
			<LCM_FUNC_CMD LCM_UTIL_WRITE_CMD_V2 4 0xB8 2 0x2E 0x00>,               
			<LCM_FUNC_CMD LCM_UTIL_WRITE_CMD_V2 4 0xB9 2 0x2E 0x2E>,               
			<LCM_FUNC_CMD LCM_UTIL_WRITE_CMD_V2 4 0xBA 2 0x2E 0x2E>,               
			<LCM_FUNC_CMD LCM_UTIL_WRITE_CMD_V2 4 0xBB 2 0x01 0x2E>,               
			<LCM_FUNC_CMD LCM_UTIL_WRITE_CMD_V2 4 0xBC 2 0x2E 0x2E>,               
			<LCM_FUNC_CMD LCM_UTIL_WRITE_CMD_V2 4 0xBD 2 0x2E 0x2E>,               
			<LCM_FUNC_CMD LCM_UTIL_WRITE_CMD_V2 4 0xBE 2 0x2E 0x2E>,               
			<LCM_FUNC_CMD LCM_UTIL_WRITE_CMD_V2 4 0xBF 2 0x0B 0x09>,               
			<LCM_FUNC_CMD LCM_UTIL_WRITE_CMD_V2 4 0xC0 2 0x1B 0x19>,               
			<LCM_FUNC_CMD LCM_UTIL_WRITE_CMD_V2 4 0xC1 2 0x17 0x15>,               
			<LCM_FUNC_CMD LCM_UTIL_WRITE_CMD_V2 4 0xC2 2 0x13 0x11>,               
			<LCM_FUNC_CMD LCM_UTIL_WRITE_CMD_V2 4 0xC3 2 0x2A 0x29>,               
			<LCM_FUNC_CMD LCM_UTIL_WRITE_CMD_V2 4 0xE5 2 0x2E 0x2E>,               
			<LCM_FUNC_CMD LCM_UTIL_WRITE_CMD_V2 4 0xC4 2 0x29 0x2A>,               
			<LCM_FUNC_CMD LCM_UTIL_WRITE_CMD_V2 4 0xC5 2 0x1B 0x19>,               
			<LCM_FUNC_CMD LCM_UTIL_WRITE_CMD_V2 4 0xC6 2 0x17 0x15>,               
			<LCM_FUNC_CMD LCM_UTIL_WRITE_CMD_V2 4 0xC7 2 0x13 0x11>,               
			<LCM_FUNC_CMD LCM_UTIL_WRITE_CMD_V2 4 0xC8 2 0x01 0x0B>,               
			<LCM_FUNC_CMD LCM_UTIL_WRITE_CMD_V2 4 0xC9 2 0x2E 0x2E>,               
			<LCM_FUNC_CMD LCM_UTIL_WRITE_CMD_V2 4 0xCA 2 0x2E 0x2E>,               
			<LCM_FUNC_CMD LCM_UTIL_WRITE_CMD_V2 4 0xCB 2 0x2E 0x2E>,               
			<LCM_FUNC_CMD LCM_UTIL_WRITE_CMD_V2 4 0xCC 2 0x2E 0x09>,               
			<LCM_FUNC_CMD LCM_UTIL_WRITE_CMD_V2 4 0xCD 2 0x2E 0x2E>,               
			<LCM_FUNC_CMD LCM_UTIL_WRITE_CMD_V2 4 0xCE 2 0x2E 0x2E>,               
			<LCM_FUNC_CMD LCM_UTIL_WRITE_CMD_V2 4 0xCF 2 0x08 0x2E>,               
			<LCM_FUNC_CMD LCM_UTIL_WRITE_CMD_V2 4 0xD0 2 0x2E 0x2E>,               
			<LCM_FUNC_CMD LCM_UTIL_WRITE_CMD_V2 4 0xD1 2 0x2E 0x2E>,               
			<LCM_FUNC_CMD LCM_UTIL_WRITE_CMD_V2 4 0xD2 2 0x2E 0x2E>,               
			<LCM_FUNC_CMD LCM_UTIL_WRITE_CMD_V2 4 0xD3 2 0x0A 0x00>,               
			<LCM_FUNC_CMD LCM_UTIL_WRITE_CMD_V2 4 0xD4 2 0x10 0x12>,               
			<LCM_FUNC_CMD LCM_UTIL_WRITE_CMD_V2 4 0xD5 2 0x14 0x16>,               
			<LCM_FUNC_CMD LCM_UTIL_WRITE_CMD_V2 4 0xD6 2 0x18 0x1A>,               
			<LCM_FUNC_CMD LCM_UTIL_WRITE_CMD_V2 4 0xD7 2 0x2A 0x29>,               
			<LCM_FUNC_CMD LCM_UTIL_WRITE_CMD_V2 4 0xE6 2 0x2E 0x2E>,               
			<LCM_FUNC_CMD LCM_UTIL_WRITE_CMD_V2 7 0xD8 5 0x00 0x00 0x00 0x00 0x00>,                
			<LCM_FUNC_CMD LCM_UTIL_WRITE_CMD_V2 7 0xD9 5 0x00 0x00 0x00 0x00 0x00>,                
			<LCM_FUNC_CMD LCM_UTIL_WRITE_CMD_V2 3 0xE7 1 0x00>,                
			        
			<LCM_FUNC_CMD LCM_UTIL_WRITE_CMD_V2 7 0xF0 5 0x55 0xAA 0x52 0x08 0x03>,                
			<LCM_FUNC_CMD LCM_UTIL_WRITE_CMD_V2 4 0xB0 2 0x00 0x00>,               
			<LCM_FUNC_CMD LCM_UTIL_WRITE_CMD_V2 4 0xB1 2 0x00 0x00>,               
			<LCM_FUNC_CMD LCM_UTIL_WRITE_CMD_V2 7 0xB2 5 0x05 0x00 0x00 0x00 0x00>,                
			        
			<LCM_FUNC_CMD LCM_UTIL_WRITE_CMD_V2 7 0xB6 5 0x05 0x00 0x00 0x00 0x00>,                
			<LCM_FUNC_CMD LCM_UTIL_WRITE_CMD_V2 7 0xB7 5 0x05 0x00 0x00 0x00 0x00>,                
			        
			<LCM_FUNC_CMD LCM_UTIL_WRITE_CMD_V2 7 0xBA 5 0x57 0x00 0x00 0x00 0x00>,            
			<LCM_FUNC_CMD LCM_UTIL_WRITE_CMD_V2 7 0xBB 5 0x57 0x00 0x00 0x00 0x00>,                
			        
			<LCM_FUNC_CMD LCM_UTIL_WRITE_CMD_V2 6 0xC0 4 0x00 0x00 0x00 0x00>,             
			<LCM_FUNC_CMD LCM_UTIL_WRITE_CMD_V2 6 0xC1 4 0x00 0x00 0x00 0x00>,             
			        
			<LCM_FUNC_CMD LCM_UTIL_WRITE_CMD_V2 3 0xC4 1 0x60>,                
			<LCM_FUNC_CMD LCM_UTIL_WRITE_CMD_V2 3 0xC5 1 0x40>,                
			        
			<LCM_FUNC_CMD LCM_UTIL_WRITE_CMD_V2 3 0xF0 5 0x55 0xAA 0x52 0x08 0x05>,                
			<LCM_FUNC_CMD LCM_UTIL_WRITE_CMD_V2 3 0xBD 5 0x03 0x01 0x03 0x03 0x03>,         
			<LCM_FUNC_CMD LCM_UTIL_WRITE_CMD_V2 4 0xB0 2 0x17 0x06>,               
			<LCM_FUNC_CMD LCM_UTIL_WRITE_CMD_V2 4 0xB1 2 0x17 0x06>,               
			<LCM_FUNC_CMD LCM_UTIL_WRITE_CMD_V2 4 0xB2 2 0x17 0x06>,               
			<LCM_FUNC_CMD LCM_UTIL_WRITE_CMD_V2 4 0xB3 2 0x17 0x06>,               
			<LCM_FUNC_CMD LCM_UTIL_WRITE_CMD_V2 4 0xB4 2 0x17 0x06>,               
			<LCM_FUNC_CMD LCM_UTIL_WRITE_CMD_V2 4 0xB5 2 0x17 0x06>,               
			        
			<LCM_FUNC_CMD LCM_UTIL_WRITE_CMD_V2 3 0xB8 1 0x00>,                
			<LCM_FUNC_CMD LCM_UTIL_WRITE_CMD_V2 3 0xB9 1 0x00>,                
			<LCM_FUNC_CMD LCM_UTIL_WRITE_CMD_V2 3 0xBA 1 0x00>,                
			<LCM_FUNC_CMD LCM_UTIL_WRITE_CMD_V2 3 0xBB 1 0x02>,                
			<LCM_FUNC_CMD LCM_UTIL_WRITE_CMD_V2 3 0xBC 1 0x00>,                
			        
			<LCM_FUNC_CMD LCM_UTIL_WRITE_CMD_V2 3 0xC0 1 0x07>,                
			        
			<LCM_FUNC_CMD LCM_UTIL_WRITE_CMD_V2 3 0xC4 1 0x80>,                
			<LCM_FUNC_CMD LCM_UTIL_WRITE_CMD_V2 3 0xC5 1 0xA4>,                
			        
			<LCM_FUNC_CMD LCM_UTIL_WRITE_CMD_V2 4 0xC8 2 0x05 0x30>,               
			<LCM_FUNC_CMD LCM_UTIL_WRITE_CMD_V2 4 0xC9 2 0x01 0x31>,               
			        
			<LCM_FUNC_CMD LCM_UTIL_WRITE_CMD_V2 5 0xCC 3 0x00 0x00 0x3C>,              
			<LCM_FUNC_CMD LCM_UTIL_WRITE_CMD_V2 5 0xCD 3 0x00 0x00 0x3C>,              
			        
			<LCM_FUNC_CMD LCM_UTIL_WRITE_CMD_V2 7 0xD1 5 0x00 0x05 0x09 0x07 0x10>,            
			<LCM_FUNC_CMD LCM_UTIL_WRITE_CMD_V2 7 0xD2 5 0x00 0x05 0x0E 0x07 0x10>,                
			        
			<LCM_FUNC_CMD LCM_UTIL_WRITE_CMD_V2 3 0xE5 1 0x06>,                
			<LCM_FUNC_CMD LCM_UTIL_WRITE_CMD_V2 3 0xE6 1 0x06>,                
			<LCM_FUNC_CMD LCM_UTIL_WRITE_CMD_V2 3 0xE7 1 0x06>,                
			<LCM_FUNC_CMD LCM_UTIL_WRITE_CMD_V2 3 0xE8 1 0x06>,                
			<LCM_FUNC_CMD LCM_UTIL_WRITE_CMD_V2 3 0xE9 1 0x06>,                
			<LCM_FUNC_CMD LCM_UTIL_WRITE_CMD_V2 3 0xEA 1 0x06>,                
			        
			<LCM_FUNC_CMD LCM_UTIL_WRITE_CMD_V2 3 0xED 1 0x30>,  		

			<LCM_FUNC_CMD LCM_UTIL_WRITE_CMD_V2 2 0x11 0>,
			<LCM_FUNC_UTIL LCM_UTIL_MDELAY 1 120>,
			<LCM_FUNC_CMD LCM_UTIL_WRITE_CMD_V2 2 0x29 0>,
			<LCM_FUNC_UTIL LCM_UTIL_MDELAY 1 40>;

		compare_id = <LCM_FUNC_UTIL LCM_UTIL_RESET 1 LCM_UTIL_RESET_HIGH>,
			<LCM_FUNC_UTIL LCM_UTIL_MDELAY 1 1>,
			<LCM_FUNC_UTIL LCM_UTIL_RESET 1 LCM_UTIL_RESET_LOW>,
			<LCM_FUNC_UTIL LCM_UTIL_MDELAY 1 10>,
			<LCM_FUNC_UTIL LCM_UTIL_RESET 1 LCM_UTIL_RESET_HIGH>,
			<LCM_FUNC_UTIL LCM_UTIL_MDELAY 1 10>,
			<LCM_FUNC_CMD LCM_UTIL_WRITE_CMD_V1 5 1 0x00 0x37 0x02 0x00>,
			<LCM_FUNC_CMD LCM_UTIL_READ_CMD_V2 3 0xF4 1 0x95>;

		suspend = <LCM_FUNC_CMD LCM_UTIL_WRITE_CMD_V2 2 0x28 0>,
			<LCM_FUNC_UTIL LCM_UTIL_MDELAY 1 10>,
			<LCM_FUNC_CMD LCM_UTIL_WRITE_CMD_V2 2 0x10 0>,
			<LCM_FUNC_UTIL LCM_UTIL_MDELAY 1 120>;
	};
	/* LCM standardization end */
};

