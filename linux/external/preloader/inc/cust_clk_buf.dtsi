/*
 * Generated by MTK SP Drv_CodeGen Version 03.13.6	for MT6735M. Copyright MediaTek Inc. (C) 2013.
 * Fri Feb 22 18:03:05 2019
 * Do Not Modify the File.
 */

/**********************************************
 *CLK_BUF DTSI File
********************************************/

&rf_clock_buffer_ctrl {
	mediatek,clkbuf-quantity = <4>;
	mediatek,clkbuf-config = <2 2 2 2>;
	status = "okay";
};
